## dts/bindings/modem/quectel,bg95.yaml
```yaml
# Copyright (c) 2023 Bjarki Arge Andreasen
# SPDX-License-Identifier: Apache-2.0

description: Quectel BG95 modem

compatible: "quectel,bg95"

include: zephyr,cellular-modem-common.yaml

properties:
  mdm-power-gpios:
    type: phandle-array
    required: true
```

## dts/bindings/modem/quectel,eg800q.yaml
```yaml
description: Quectel EG800Q modem

compatible: "quectel,eg800q"

include: zephyr,cellular-modem-common.yaml

properties:
  mdm-power-gpios:
    type: phandle-array
    required: true
```

## dts/bindings/modem/zephyr,cellular-modem-common.yaml
```yaml
# Copyright 2025 Nordic Semiconductor ASA
# SPDX-License-Identifier: Apache-2.0

description: Common properties for Zephyr cellular modems

include: uart-device.yaml

properties:
  mdm-power-gpios:
    type: phandle-array
    description: GPIO for modem power control

  mdm-reset-gpios:
    type: phandle-array
    description: GPIO for modem reset

  mdm-wake-gpios:
    type: phandle-array
    description: GPIO for modem wake

  mdm-ring-gpios:
    type: phandle-array
    description: GPIO for modem ring indicator

  cmux-runtime-pm:
    type: boolean
    description: Enable runtime power management for CMUX driver
```

## samples/net/zperf/boards/nrf9160dk_nrf52840.conf
```kconfig
# Align with the Serial LTE Modem (SLM) application.
CONFIG_MODEM_CMUX_MTU=127
CONFIG_MODEM_CMUX_WORK_BUFFER_SIZE=665
CONFIG_MODEM_CELLULAR_UART_BUFFER_SIZES=402
CONFIG_MODEM_BACKEND_UART_ASYNC_HWFC_BUFFER_COUNT=3
CONFIG_MODEM_CMUX_LOG_LEVEL_DBG=y
CONFIG_MODEM_CELLULAR_PERIODIC_SCRIPT_MS=60000
CONFIG_MODEM_CMUX_T3_TIMEOUT=1

# Networking
CONFIG_NETWORKING=y
CONFIG_NET_NATIVE=y
CONFIG_NET_L2_PPP=y
CONFIG_NET_L2_ETHERNET=n
CONFIG_NET_IPV4=y
CONFIG_NET_UDP=y
CONFIG_NET_SOCKETS=y
CONFIG_NET_CONTEXT_RCVTIMEO=y

# DNS
CONFIG_DNS_RESOLVER=y
CONFIG_DNS_RESOLVER_MAX_SERVERS=4
CONFIG_NET_L2_PPP_OPTION_DNS_USE=y

# Network management
CONFIG_NET_MGMT=y
CONFIG_NET_MGMT_EVENT=y
CONFIG_NET_CONNECTION_MANAGER=y

# Modem driver
CONFIG_MODEM=y
CONFIG_MODEM_CELLULAR=y
CONFIG_PM_DEVICE=y

CONFIG_UART_INTERRUPT_DRIVEN=n
CONFIG_UART_ASYNC_API=y
CONFIG_UART_0_INTERRUPT_DRIVEN=n
CONFIG_UART_0_ASYNC=y
CONFIG_UART_1_ASYNC=y
CONFIG_UART_1_INTERRUPT_DRIVEN=n
CONFIG_UART_USE_RUNTIME_CONFIGURE=y

CONFIG_ZVFS_POLL_MAX=20
CONFIG_PM_DEVICE_RUNTIME=y
CONFIG_PM_DEVICE_RUNTIME_USE_DEDICATED_WQ=y
CONFIG_PM_DEVICE_SHELL=y

CONFIG_GPIO=y
CONFIG_GPIO_SHELL=y
CONFIG_PM_DEVICE_SHELL=y

CONFIG_CACHE_MANAGEMENT=n
CONFIG_NET_CONFIG_SETTINGS=n
CONFIG_NET_CONFIG_MY_IPV6_ADDR=""
CONFIG_NET_CONFIG_PEER_IPV6_ADDR=""
CONFIG_NET_CONFIG_MY_IPV4_ADDR=""
CONFIG_NET_CONFIG_PEER_IPV4_ADDR=""

CONFIG_SHELL_BACKEND_SERIAL_API_ASYNC=y
```
